## board/friendlyarm/smart210/Kconfig
```kconfig
if TARGET_SMART210

config SYS_BOARD
	default "smart210"

config SYS_VENDOR
	default "friendlyarm"

config SYS_SOC
	default "s5pc1xx"

config SYS_CONFIG_NAME
	default "smart210"

endif
```

## configs/smart210_defconfig
```kconfig
CONFIG_ARM=y
CONFIG_ARCH_S5PC1XX=y
CONFIG_TARGET_SMART210=y
CONFIG_DEFAULT_DEVICE_TREE="s5pc1xx-smart210"
CONFIG_SYS_CONSOLE_IS_IN_ENV=y
CONFIG_MMC_SDHCI=y
CONFIG_MMC_SDHCI_S5P=y
CONFIG_SPL=y
CONFIG_BOOTDELAY=3
CONFIG_HUSH_PARSER=y
CONFIG_SYS_PROMPT="SMART210 # "
# CONFIG_AUTOBOOT is not set
# CONFIG_CMD_IMLS is not set
# CONFIG_CMD_XIMG is not set
# CONFIG_CMD_FLASH is not set
CONFIG_CMD_MMC=y
# CONFIG_CMD_FPGA is not set
# CONFIG_CMD_SETEXPR is not set
CONFIG_CMD_NET=y
CONFIG_CMD_PING=y
# CONFIG_CMD_NFS is not set
CONFIG_CMD_CACHE=y
# CONFIG_CMD_MISC is not set
CONFIG_CMD_NAND=y
CONFIG_NAND_S5PC110=y
CONFIG_S5PC110_NAND_HWECC=y
```
