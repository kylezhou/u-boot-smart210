/*
 * FriendlyARM's S5PV210-based Smart210 board device tree source
 *
 * Copyright (c) 2014 Google, Inc
 *
 * SPDX-License-Identifier:	GPL-2.0+
 */

/dts-v1/;

#include "skeleton.dtsi"
#include "s5pc110-pinctrl.dtsi"

/ {
	model = "FriendlyARM Smart210 based on S5PV210";
	compatible = "friendlyarm,smart210", "samsung,s5pv210";

	aliases {
		serial2 = "/serial@e2900800";
		console = "/serial@e2900800";
		pinctrl0 = &pinctrl0;
	};

	pinctrl0: pinctrl@e0200000 {
		compatible = "samsung,s5pc110-pinctrl";
		reg = <0xe0200000 0x1000>;
	};

	serial@e2900800 {
		compatible = "samsung,exynos4210-uart";
		reg = <0xe2900800 0x400>;
		id = <2>;
	};

};
